## conf/bblayers.conf.sample
```bitbake
POKY_BBLAYERS_CONF_VERSION = "2"

BBPATH = "${TOPDIR}"
BBFILES ?= ""

BBLAYERS ?= " \
    ##OEROOT##/meta \
    ##OEROOT##/meta-poky \
    ##OEROOT##/meta-yocto-bsp \
    ##OEROOT##/meta-openembedded/meta-oe \
    ##OEROOT##/meta-openembedded/meta-python \
    ##OEROOT##/meta-openembedded/meta-networking \
    ##OEROOT##/meta-openembedded/meta-filesystems \
    ##OEROOT##/meta-raspberrypi \
    ##OEROOT##/meta-elk \
    ##OEROOT##/meta-nina \
    ##OEROOT##/meta-raspberrypi-elk \
    ##OEROOT##/meta-raspberrypi-nina \
    ##OEROOT##/meta-elkpi \
    ##OEROOT##/meta-ninapi \
    ##OEROOT##/meta-swupdate-nina \
    ##OEROOT##/meta-swupdate \
"
# uncomment to enable qt5 in image
BBLAYERS += "##OEROOT##/meta-qt5 "
```

## conf/layer.conf
```bitbake
# We have a conf and classes directory, add to BBPATH
BBPATH .= ":${LAYERDIR}"

# We have recipes-* directories, add to BBFILES
BBFILES += "${LAYERDIR}/recipes-*/*/*.bb \
            ${LAYERDIR}/recipes-*/*/*.bbappend"

BBFILE_COLLECTIONS += "meta-ninapi"
BBFILE_PATTERN_meta-ninapi = "^${LAYERDIR}/"
BBFILE_PRIORITY_meta-ninapi = "10"
LAYERSERIES_COMPAT_meta-ninapi = "hardknott dunfell"
BBMASK += "meta-elk/recipes-devtools/clang/clang_git.bbappend"
```
